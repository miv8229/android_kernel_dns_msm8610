/* Copyright (c) 2013, The Linux Foundation. All rights reserved.
 *
 * This program is free software; you can redistribute it and/or modify
 * it under the terms of the GNU General Public License version 2 and
 * only version 2 as published by the Free Software Foundation.
 *
 * This program is distributed in the hope that it will be useful,
 * but WITHOUT ANY WARRANTY; without even the implied warranty of
 * MERCHANTABILITY or FITNESS FOR A PARTICULAR PURPOSE.  See the
 * GNU General Public License for more details.
 */

qcom,qrd-4v2-2000mah-data {
	qcom,fcc-mah = <2000>;
	qcom,default-rbatt-mohm = <174>;
	qcom,rbatt-capacitive-mohm = <0>;
	qcom,flat-ocv-threshold-uv = <3800000>;
	qcom,max-voltage-uv = <4200000>;
	qcom,v-cutoff-uv = <3400000>;
	qcom,chg-term-ua = <100000>;
	qcom,batt-id-kohm = <47>;

		qcom,rbatt-sf-lut {
				qcom,lut-col-legend = <0xffffffec 0x0>,
						      <0x19 0x28 0x3c>;
				qcom,lut-row-legend = <0x64 0x5f 0x5a 0x55>,
						      <0x50 0x4b 0x46 0x41>,
						      <0x3c 0x37 0x32 0x2d>,
						      <0x28 0x23 0x1e 0x19>,
						      <0x14 0x10 0xd 0xb>,
						      <0xa 0x9 0x8 0x7>, 
						      <0x6 0x5 0x4 0x3 0x2 0x1>;
				qcom,lut-data = <0x2c8 0xeb 0x64 0x54>,
						<0x51 0x2c8 0xee 0x64>,
						<0x54 0x51 0x2c2 0xef>,
						<0x67 0x56 0x52 0x2bd>,
						<0xef 0x6c 0x59 0x54>,
						<0x2bd 0xf0 0x71 0x5d>,
						<0x56 0x2c2 0xe9 0x78>,
						<0x60 0x59 0x2a9 0xe7>,
						<0x7d 0x65 0x5b 0x2af>,
						<0xe8 0x76 0x6a 0x5f>,
						<0x2b6 0xe7 0x68 0x63>,
						<0x5c 0x2b9 0xe7 0x64>,
						<0x56 0x52 0x2c0 0xe8>,
						<0x64 0x56 0x53 0x2c8>,
						<0xe9 0x66 0x58 0x55>,
						<0x2d4 0xea 0x68 0x5a>,
						<0x57 0x2e5 0xeb 0x6a>,
						<0x5c 0x59 0x2ff 0xeb>,
						<0x69 0x5b 0x56 0x325>,
						<0xe9 0x67 0x57 0x53>,
						<0x357 0xf3 0x66 0x57>,
						<0x54 0x381 0x104 0x65>,
						<0x57 0x54 0x363 0x112>,
						<0x62 0x55 0x53 0x357>,
						<0x115 0x62 0x55 0x54>,
						<0x372 0x117 0x63 0x56>,
						<0x55 0x392 0x111 0x65>,
						<0x57 0x56 0x3bd 0x117>,
						<0x67 0x59 0x57 0x3f2>,
						<0x121 0x6a 0x5b 0x5b>,
						<0x435 0x129 0x6c 0x5b>,
						<0x61 0x4a1 0x13c 0x67>,
						<0x58 0x64 0x57b 0x165>,
						<0x66 0x59 0x66 0x6dc>,
						<0x1bd 0x6a 0x5b 0x6e>,
						<0x95b 0x2ac 0x72 0x62>,
						<0x7e 0x2278 0x96b 0x9f 0x80 0xba>;
			};

			qcom,fcc-temp-lut {
				qcom,lut-col-legend = <0xffffffec 0x0 0x19 0x28 0x3c>;
				qcom,lut-data = <0x807 0x7de 0x801 0x801 0x7f6>;
			};

			qcom,pc-temp-ocv-lut {
				qcom,lut-col-legend = <0xffffffec 0x0 0x19 0x28 0x3c>;
				qcom,lut-row-legend = <0x64 0x5f 0x5a 0x55>,
						      <0x50 0x4b 0x46 0x41>,
						      <0x3c 0x37 0x32 0x2d>,
						      <0x28 0x23 0x1e 0x19>,
						      <0x14 0x10 0xd 0xb>,
						      <0xa 0x9 0x8 0x7>,
						      <0x6 0x5 0x4 0x3 0x2 0x1 0x0>;
				qcom,lut-data = <0x10e0 0x10cf 0x10d6 0x10d6>,
						<0x10ce 0x108c 0x108c 0x1096>,
						<0x1095 0x108f 0x104e 0x1051>,
						<0x105d 0x105c 0x1057 0x1013>,
						<0x1017 0x1028 0x1026 0x1020>,
						<0xfde 0xfe7 0xff5 0xff3>,
						<0xfec 0xf95 0xf95 0xfc3>,
						<0xfc3 0xfbb 0xf4c 0xf5f>,
						<0xf87 0xf90 0xf8f 0xf2e>,
						<0xf44 0xf62 0xf6a 0xf65>,
						<0xf13 0xf24 0xf33 0xf3c>,
						<0xf37 0xef4 0xf06 0xf11>,
						<0xf12 0xf0e 0xeda 0xeec>,
						<0xef8 0xef8 0xef3 0xec3>,
						<0xed6 0xee3 0xee3 0xede>,
						<0xeb1 0xec4 0xed1 0xed2>,
						<0xece 0xea4 0xeb6 0xec3>,
						<0xec3 0xebe 0xe99 0xeaa>,
						<0xeb7 0xeb4 0xea7 0xe8c>,
						<0xe9d 0xeaa 0xea2 0xe91>,
						<0xe7a 0xe92 0xe99 0xe90>,
						<0xe7e 0xe68 0xe88 0xe86>,
						<0xe7d 0xe6a 0xe57 0xe7f>,
						<0xe72 0xe69 0xe5a 0xe4a>,
						<0xe78 0xe6c 0xe63 0xe56>,
						<0xe41 0xe73 0xe6b 0xe62>,
						<0xe55 0xe36 0xe6e 0xe69>,
						<0xe61 0xe52 0xe2a 0xe67>,
						<0xe68 0xe5f 0xe4a 0xe1c>,
						<0xe5c 0xe65 0xe5c 0xe3b>,
						<0xe0a 0xe4a 0xe5c 0xe51>,
						<0xe26 0xdf4 0xe2e 0xe3f>,
						<0xe32 0xe05 0xdd6 0xe05>,
						<0xe11 0xe04 0xdd8 0xdad>,
						<0xdca 0xdd6 0xdc8 0xd9f>,
						<0xd6b 0xd78 0xd85 0xd79>,
						<0xd54 0xcec 0xcf8 0xd0c>,
						<0xcff 0xce0 0xbb8 0xbb8>,
						<0xbb8 0xbb8 0xbb8>;
			};
};
