/* Copyright (c) 2013, The Linux Foundation. All rights reserved.
 *
 * This program is free software; you can redistribute it and/or modify
 * it under the terms of the GNU General Public License version 2 and
 * only version 2 as published by the Free Software Foundation.
 *
 * This program is distributed in the hope that it will be useful,
 * but WITHOUT ANY WARRANTY; without even the implied warranty of
 * MERCHANTABILITY or FITNESS FOR A PARTICULAR PURPOSE.  See the
 * GNU General Public License for more details.
 */

/*---------------------------------------------------------------------------
 * This file is autogenerated file using gcdb parser. Please do not edit it.
 * Update input XML file to add a new entry or update variable in this file
 * VERSION = "1.0"
 *---------------------------------------------------------------------------*/
&mdss_mdp {
	dsi_nt35517_qhd_vid: qcom,mdss_dsi_nt35517_qhd_video {
		compatible = "qcom,mdss-dsi-panel";
		status = "disable";
		qcom,mdss-dsi-panel-name = "nt35517 video mode dsi panel";
		qcom,mdss-dsi-panel-controller = <&mdss_dsi0>;
		qcom,mdss-dsi-panel-width = <540>;
		qcom,mdss-dsi-panel-height = <960>;
		qcom,mdss-pan-physical-width-dimension = <0>;
		qcom,mdss-pan-physical-height-dimension = <0>;
		qcom,mdss-dsi-h-left-border = <0>;
		qcom,mdss-dsi-h-right-border = <0>;
		qcom,mdss-dsi-v-top-border = <0>;
		qcom,mdss-dsi-v-bottom-border = <0>;
		qcom,mdss-dsi-bpp = <24>;
		qcom,mdss-dsi-panel-type = "dsi_video_mode";
		qcom,mdss-dsi-pixel-packing = <0>; /* used for 16bit mode*/
		qcom,mdss-dsi-panel-destination = "display_1";
		qcom,mdss-dsi-h-front-porch = <0x64>;
		qcom,mdss-dsi-h-back-porch = <0x64>;
		qcom,mdss-dsi-h-pulse-width = <0x8>;
		qcom,mdss-dsi-h-sync-skew = <0x0>;
		qcom,mdss-dsi-v-back-porch = <0x14>;
		qcom,mdss-dsi-v-front-porch = <0x14>;
		qcom,mdss-dsi-v-pulse-width = <0x1>;
		qcom,mdss-dsi-panel-clock-rate = <449040000>;
		qcom,mdss-dsi-panel-timings = <0x5e291f01 0x3e37242b 0x34030400>;
		qcom,mdss-dsi-t-clk-post = <0x20>;
		qcom,mdss-dsi-t-clk-pre = <0x2c>;
		qcom,mdss-dsi-underflow-color = <0xff>;
		qcom,mdss-dsi-border-color = <0>;
		qcom,mdss-dsi-bl-pmic-control-type = "bl_ctrl_wled";
		qcom,mdss-dsi-bl-min-level = <0x14>;
		qcom,mdss-dsi-bl-max-level = <0xcd>;
		qcom,mdss-dsi-interleave-mode = <0>;
		qcom,mdss-dsi-esd-enable;
		qcom,mdss-dsi-esd-detect-mode= <0>;
		qcom,mdss-dsi-h-sync-pulse = <1>;
		qcom,mdss-dsi-bllp-power-mode;
		qcom,mdss-dsi-bllp-eof-power-mode;
		qcom,mdss-dsi-traffic-mode = <1>;
		qcom,mdss-dsi-panel-framerate = <0x3c>;
		qcom,mdss-dsi-te-dcs-command = <1>;
		qcom,mdss-dsi-te-v-sync-continue-lines = <0x3c>;
		qcom,mdss-dsi-te-v-sync-rd-ptr-irq-line = <0x2c>;
		qcom,mdss-dsi-te-pin-select = <1>;
		qcom,mdss-dsi-stream = <0>;
		qcom,mdss-dsi-mdp-trigger = <0>;
		qcom,mdss-dsi-dma-trigger = <4>;
		qcom,mdss-dsi-virtual-channel-id = <0>;
		qcom,mdss-dsi-color-order = <0x0>;
		qcom,mdss-dsi-lane-0-state;
		qcom,mdss-dsi-lane-1-state;
		qcom,mdss-dsi-on-command = [39 01 00 00 00 00 05 ff aa 55 25 01 39 01 00 00 00 00 06 f0 55 aa 52 08 00 39 01 00 00 00 00 02 b1 fc 39 01 00 00 00 00 05 b8 01 02 02 02 39 01 00 00 00 00 07 c9 63 06 0d 1a 17 00 39 01 00 00 00 00 03 e0 01 03 39 01 00 00 00 00 06 f0 55 aa 52 08 01 39 01 00 00 00 00 04 b0 05 05 05 39 01 00 00 00 00 04 b1 05 05 05 39 01 00 00 00 00 04 b2 02 02 02 39 01 00 00 00 00 04 b3 0e 0e 0e 39 01 00 00 00 00 04 b4 08 08 08 39 01 00 00 00 00 04 b6 34 34 34 39 01 00 00 00 00 04 b7 34 34 34 39 01 00 00 00 00 04 b8 15 15 15 39 01 00 00 00 00 04 b9 22 22 22 39 01 00 00 00 00 04 ba 23 23 23 39 01 00 00 00 00 04 bc 00 88 00 39 01 00 00 00 00 04 bd 00 88 00 39 01 00 00 00 00 02 be 6c 39 01 00 00 00 00 03 c0 04 00 39 01 00 00 00 00 02 ca 00 39 01 00 00 00 00 11 d1 00 00 00 55 00 85 00 a3 00 ba 00 e0 00 fd 01 2a 39 01 00 00 00 00 11 d2 01 4d 01 84 01 ae 01 f0 02 28 02 2a 02 60 02 9f 39 01 00 00 00 00 11 d3 02 ca 03 05 03 29 03 5b 03 79 03 a0 03 b3 03 d3 39 01 00 00 00 00 05 d4 03 e6 03 ff 39 01 00 00 00 00 11 d5 00 00 00 55 00 85 00 a3 00 ba 00 e0 00 fd 01 2a 39 01 00 00 00 00 11 d6 01 4d 01 84 01 ae 01 f0 02 28 02 2a 02 60 02 9f 39 01 00 00 00 00 11 d7 02 ca 03 05 03 29 03 5b 03 79 03 a0 03 b3 03 d3 39 01 00 00 00 00 05 d8 03 e6 03 ff 39 01 00 00 00 00 11 d9 00 00 00 55 00 85 00 a3 00 ba 00 e0 00 fd 01 2a 39 01 00 00 00 00 11 dd 01 4d 01 84 01 ae 01 f0 02 28 02 2a 02 60 02 9f 39 01 00 00 00 00 11 de 02 ca 03 05 03 29 03 5b 03 79 03 a0 03 b3 03 d3 39 01 00 00 00 00 05 df 03 e6 03 ff 39 01 00 00 00 00 11 e0 00 00 00 55 00 85 00 a3 00 ba 00 e0 00 fd 01 2a 39 01 00 00 00 00 11 e1 01 4d 01 84 01 ae 01 f0 02 28 02 2a 02 60 02 9f 39 01 00 00 00 00 11 e2 02 ca 03 05 03 29 03 5b 03 79 03 a0 03 b3 03 d3 39 01 00 00 00 00 05 e3 03 e6 03 ff 39 01 00 00 00 00 11 e4 00 00 00 55 00 85 00 a3 00 ba 00 e0 00 fd 01 2a 39 01 00 00 00 00 11 e5 01 4d 01 84 01 ae 01 f0 02 28 02 2a 02 60 02 9f 39 01 00 00 00 00 11 e6 02 ca 03 05 03 29 03 5b 03 79 03 a0 03 b3 03 d3 39 01 00 00 00 00 05 e7 03 e6 03 ff 39 01 00 00 00 00 11 e8 00 00 00 55 00 85 00 a3 00 ba 00 e0 00 fd 01 2a 39 01 00 00 00 00 11 e9 01 4d 01 84 01 ae 01 f0 02 28 02 2a 02 60 02 9f 39 01 00 00 00 00 11 ea 02 ca 03 05 03 29 03 5b 03 79 03 a0 03 b3 03 d3 39 01 00 00 00 00 05 eb 03 e6 03 ff 05 01 00 00 78 00 02 11 00 05 01 00 00 28 00 02 29 00];
		qcom,mdss-dsi-off-command = [05 01 00 00 c8 00 02 28 00 05 01 00 00 c8 00 02 10 00];
		qcom,mdss-dsi-lane-map = "lane_map_3012";/*Modified by Xiaodong.Chen at 2014.1.17 for compatible codec baseline about LNX.LA.3.2.1-05810-8x10.0*/
		qcom,mdss-dsi-on-command-state = "dsi_lp_mode";
		qcom,mdss-dsi-off-command-state = "dsi_hs_mode";
		qcom,mdss-dsi-reset-sequence = <1 20>, <0 2>, <1 20>;
	};
};
